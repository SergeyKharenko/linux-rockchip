// SPDX-License-Identifier: (GPL-2.0+ OR MIT)
/*
 * Copyright (c) 2025 Sergey Kharenko
 * Copyright (c) 2021 Rockchip Electronics Co., Ltd.
 */

 /dts-v1/;

#include "rk3399pro.dtsi"
#include "rk3399-linux.dtsi"
#include "rk3399-opp.dtsi"
#include "rk3399-vop-clk-set.dtsi"

